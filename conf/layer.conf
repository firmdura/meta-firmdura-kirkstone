## conf/layer.conf
```bitbake
# SPDX-License-Identifier: MIT
BBPATH .= ":${LAYERDIR}"
BBFILES += "${LAYERDIR}/recipes-*/*/*.bb ${LAYERDIR}/recipes-*/*/*.bbappend"

BBFILE_COLLECTIONS += "firmdura"
BBFILE_PATTERN_firmdura = "^${LAYERDIR}/"
BBFILE_PRIORITY_firmdura = "7"
LAYERSERIES_COMPAT_firmdura = "kirkstone"
LAYERDEPENDS_firmdura = "core openembedded-layer"
```

## meta-firmdura-tests/conf/layer.conf
```bitbake
# SPDX-License-Identifier: MIT
BBPATH .= ":${LAYERDIR}"
BBFILES += "${LAYERDIR}/recipes-*/*/*.bb ${LAYERDIR}/recipes-*/*/*.bbappend"

BBFILE_COLLECTIONS += "firmdura_tests"
BBFILE_PATTERN_firmdura_tests = "^${LAYERDIR}/"
BBFILE_PRIORITY_firmdura_tests = "7"
LAYERSERIES_COMPAT_firmdura_tests = "kirkstone"
LAYERDEPENDS_firmdura_tests = "core openembedded-layer"
```
